## conf/distro/include/meta_intel_sgx_security_flags.inc
```bitbake
# Build errors with the pie options enabled
SECURITY_CFLAGS:pn-protobuf = "${SECURITY_NO_PIE_CFLAGS}"
```

## conf/distro/meta-intel-sgx.conf
```bitbake
DISTRO = "meta-intel-sgx"
DISTROOVERRIDES = "sgx"

SDKIMAGE_FEATURES += "dev-pkgs staticdev-pkgs dbg-pkgs"

DISTRO_FEATURES += "ldconfig"
```

## conf/layer.conf
```bitbake
BBPATH := "${BBPATH}:${LAYERDIR}"

BBFILES += "${LAYERDIR}/recipes-*/*/*.bb \
            ${LAYERDIR}/recipes-*/*/*.bbappend \
            "

# Add layer-specific bbappends only when the relevant layer is available
BBFILES += "${@' '.join('${LAYERDIR}/%s/recipes-*/*/*.bbappend' % layer \
               for layer in BBFILE_COLLECTIONS.split())}"

BBFILE_COLLECTIONS += "sgx"
BBFILE_PATTERN_sgx := "^${LAYERDIR}/"
BBFILE_PRIORITY_sgx = "9"

LAYERDEPENDS_sgx = "core openembedded-layer"

# Override security flags
require conf/distro/include/meta_intel_sgx_security_flags.inc

LAYERSERIES_COMPAT_sgx = "sumo"
```
